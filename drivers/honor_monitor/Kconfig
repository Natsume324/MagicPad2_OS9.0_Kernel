## drivers/honor_monitor/Kconfig
```kconfig
config HN_MONITOR
	tristate "hn monitor"
	default n

config HN_MONITOR_GKI
	bool "hn monitor for gki"
	depends on HN_MONITOR
	default n
```

## drivers/micro_dump/Kconfig
```kconfig
config HN_MICRODUMP
	bool "micro dump."
	default n

config HN_MICRODUMP_DEFAULT_ENABLE
	bool "microdump default enable."
	default n

config HN_MICRODUMP_TEST
	bool "micro dump test"
	depends on HN_MICRODUMP
	default n
```

## drivers/runtime_verification/Kconfig
```kconfig
#
# Runtime Verification configuration
#
menu "honor runtime verification support"

config RUNTIME_VERIFICATION_LOGGER
	tristate "runtime verification log driver"
	default n
	depends on LOGGER
        depends on KRETPROBES
	help
          This adds support for verification event buffer.
          This adds support for kernel functional instrument.
endmenu
```

## kernel/sched/honor_async_binder_rt/Kconfig
```kconfig
# Add iAware async binder rt
config HN_SET_ASYNC_BINDER_RT
	bool "iaware 7.0 set async binder rt"
	default n
	help
	  if set, the priority of opposite binder thread(include releaseBufferCallback,updateInputFlinger and startAnimation) will be set to realtime
config HN_ASYNC_BINDER_THREAD_PRIO_RT
	bool "iaware 7.0 set async binder rt"
	default n
	help
	  if set, the priority of opposite binder thread(include releaseBufferCallback) will be set to realtime
```

## mm/mem_stats/memlock_stats/Kconfig
```kconfig
config HONOR_MEMLOCK_STATS
	bool "Honor memory lock statistics"
	default n
	help
	  Honor memory lock accounting. Never use it as a kernel module.
```

## mm/mem_stats/mmonitor/Kconfig
```kconfig
config MEMORY_MONITOR
	bool "memory monitor"
	default n
	help
	  memory monitor

config SLOW_PATH_COUNT
	bool "page alloc enter slow path count"
	default n
	help
	  Say 'Y' here is you want to count page alloc slow path.
```

## mm/mem_stats/page_lock/Kconfig
```kconfig
config DEBUG_PAGE_LOCK
	bool "Debug page locking"
	depends on DEBUG_KERNEL
	select PAGE_EXTENSION
	select DEBUG_FS
	help
	  This keeps track of what call chain is the owner of a lock page.
	  If unsure, say N.
```

## mm/mem_stats/reclaim_acct/Kconfig
```kconfig
config RECLAIM_ACCT
	bool "Honor memory reclaim delay accounting"
	default n
	help
	  Honor memory reclaim delay accounting. Never use it as a kernel module.
```
